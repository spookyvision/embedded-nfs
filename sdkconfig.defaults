## sdkconfig.defaults
```kconfig
# disable watchdog
# CONFIG_ESP_INT_WDT=n

# Set to VERBOSE to debug issues if things aren't working properly... for your
# application you probably want INFO.
#CONFIG_LOG_DEFAULT_LEVEL_VERBOSE=y
#CONFIG_LOG_MAXIMUM_EQUALS_DEFAULT=y

# The tokio runtime and typical programs built with it need quite a bit of
# stack space, but the good news is that you don't need many pthreads for
# a complete application.
CONFIG_ESP_MAIN_TASK_STACK_SIZE=20000
#CONFIG_ESP_SYSTEM_EVENT_TASK_STACK_SIZE=16000


# from https://github.com/ivmarkov/ruwm/blob/master/sdkconfig.defaults
# For async-io
#CONFIG_PTHREAD_TASK_STACK_SIZE_DEFAULT=4096

# from https://github.com/ivmarkov/ruwm/blob/master/sdkconfig.defaults
# Go figure...
#CONFIG_FREERTOS_IDLE_TASK_STACKSIZE=4096



# Use this to set FreeRTOS kernel tick frequency to 1000 Hz (100 Hz by default).
# This allows to use 1 ms granuality for thread sleeps (10 ms by default).
CONFIG_FREERTOS_HZ=1000

# Workaround for https://github.com/espressif/esp-idf/issues/7631
#CONFIG_MBEDTLS_CERTIFICATE_BUNDLE=n
#CONFIG_MBEDTLS_CERTIFICATE_BUNDLE_DEFAULT_FULL=n
```
